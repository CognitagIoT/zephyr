## boards/arm/mg100/Kconfig.defconfig
```kconfig
# Copyright (c) 2022 Laird Connectivity
# SPDX-License-Identifier: Apache-2.0

if BOARD_MG100

config BOARD
	default "mg100"

config MODEM
	default y if NETWORKING

config MODEM_HL7800
	default y if NETWORKING

config NORDIC_QSPI_NOR
	default y if BOOTLOADER_MCUBOOT

config NORDIC_QSPI_NOR_FLASH_LAYOUT_PAGE_SIZE
	default 4096 if NORDIC_QSPI_NOR

config REGULATOR
	default y if DISK_DRIVER_SDMMC

config BT_CTLR
	default y if BT

endif # BOARD_MG100
```
